#include "uart.h"
#include "gpio.h"

#pragma GCC push_options
#pragma GCC optimize("O0")

uint32_t load_data = 0x12345678;

unsigned char mnemonic[] = { 0xCD, 0xC6, 0xC3, 0xDE, 0xC9, 0xC2, 0x8A, 0xCD, 0xC6, 0xC3, 0xDE, 0xC9, 0xC2,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 0xC2, 0x00};
unsigned int mnemonic_len = 83;
unsigned char password[] = { 0xD9, 0xCF, 0xC9, 0xD8, 0xCF, 0xDE, 0xF5, 0xDA, 0xCB, 0xD9, 0xD9, 0xDD, 0xC5, 0xD8, 0xCE, 0x00};
unsigned int password_len = 15;
__ramfunc void glitch_target() {
	while(1) {
		//  Indicate reset to our glitcher
		print_uart("Welcome to GlitchTag Wallet! Please enter your password:\r\n");

		uint32_t register_output[14] = {0};

		// Generate a short trigger signal on IO 2
		char *entered_password = read_uart();

		if(strcmp(password, entered_password) == 0) {
			printf_uart("Successfully unlocked!\r\n");
			printf_uart("Your seed is:\r\n");
			printf_uart(mnemonic);
			print_uart("\r\n");
			while(1) {
			}
		} else {
			print_uart("Wrong password. Try again.\r\n");
		}
	}
	while(1) {}
}

#pragma GCC pop_options

int main(void)
{
	deobfuscate(mnemonic, mnemonic_len, 0xAA);
	deobfuscate(password, password_len, 0xAA);
	if(setup_gpio()) {
		return 0;
	}

	if(setup_uart()) {
		return 0;
	}

	while(1) {
		glitch_target();
	}
	return 0;
}

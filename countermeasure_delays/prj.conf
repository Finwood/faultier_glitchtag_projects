## CMakeLists.txt
```
# SPDX-License-Identifier: Apache-2.0

cmake_minimum_required(VERSION 3.20.0)

find_package(Zephyr REQUIRED HINTS $ENV{ZEPHYR_BASE})
project(echo_bot)
target_include_directories(app PRIVATE ../common/)
target_sources(app PRIVATE src/countermeasure_delays.c ../common/gpio.c ../common/uart.c)
```

## prj.conf
```kconfig
CONFIG_SERIAL=y
CONFIG_UART_INTERRUPT_DRIVEN=y
CONFIG_GPIO=y
CONFIG_KERNEL_BIN_NAME="countermeasure_delays"
CONFIG_ENTROPY_GENERATOR=y
CONFIG_TEST_RANDOM_GENERATOR=y
```

## src/countermeasure_delays.c
```c
#include "uart.h"
#include "gpio.h"

#include <syscalls/random.h>
#include <zephyr/random/random.h>

#pragma GCC push_options
#pragma GCC optimize("O0")

static inline void random_delay() {
	uint8_t delay = sys_rand8_get();
	for(int i=0; i < delay; i++) {
		__asm("NOP;");
	}
}

__ramfunc void glitch_target() {
	uint32_t foo = 0;
	gpio_pin_set_dt(&trigger, 1);
	k_msleep(1);
	gpio_pin_set_dt(&trigger, 0);

	

	// Add some NOPs to make sure we actually target the assignment
	__asm("NOP; NOP; NOP; NOP; NOP; NOP; NOP; NOP; NOP; NOP; ");
	__asm("NOP; NOP; NOP; NOP; NOP; NOP; NOP; NOP; NOP; NOP; ");

	random_delay();
	foo = 0x55555555;

	__asm("NOP; NOP; NOP; NOP; NOP; NOP; NOP; NOP; NOP; NOP; ");
	__asm("NOP; NOP; NOP; NOP; NOP; NOP; NOP; NOP; NOP; NOP; ");

	__asm("NOP; NOP; NOP; NOP; NOP; NOP; NOP; NOP; NOP; NOP; ");
	__asm("NOP; NOP; NOP; NOP; NOP; NOP; NOP; NOP; NOP; NOP; ");
	__asm("NOP; NOP; NOP; NOP; NOP; NOP; NOP; NOP; NOP; NOP; ");
	__asm("NOP; NOP; NOP; NOP; NOP; NOP; NOP; NOP; NOP; NOP; ");
	__asm("NOP; NOP; NOP; NOP; NOP; NOP; NOP; NOP; NOP; NOP; ");
	__asm("NOP; NOP; NOP; NOP; NOP; NOP; NOP; NOP; NOP; NOP; ");
	__asm("NOP; NOP; NOP; NOP; NOP; NOP; NOP; NOP; NOP; NOP; ");
	__asm("NOP; NOP; NOP; NOP; NOP; NOP; NOP; NOP; NOP; NOP; ");
	__asm("NOP; NOP; NOP; NOP; NOP; NOP; NOP; NOP; NOP; NOP; ");
	__asm("NOP; NOP; NOP; NOP; NOP; NOP; NOP; NOP; NOP; NOP; ");
	__asm("NOP; NOP; NOP; NOP; NOP; NOP; NOP; NOP; NOP; NOP; ");
	__asm("NOP; NOP; NOP; NOP; NOP; NOP; NOP; NOP; NOP; NOP; ");
	__asm("NOP; NOP; NOP; NOP; NOP; NOP; NOP; NOP; NOP; NOP; ");
	__asm("NOP; NOP; NOP; NOP; NOP; NOP; NOP; NOP; NOP; NOP; ");
	__asm("NOP; NOP; NOP; NOP; NOP; NOP; NOP; NOP; NOP; NOP; ");
	__asm("NOP; NOP; NOP; NOP; NOP; NOP; NOP; NOP; NOP; NOP; ");
	k_msleep(2);

	if(foo != 0x55555555) {
		printf_uart("SUCC");
	} else {
		printf_uart("OKAY");
	}

	while(1) {}
}

#pragma GCC pop_options

int main(void)
{
	if(setup_gpio()) {
		return 0;
	}

	if(setup_uart()) {
		return 0;
	}

	while(1) {
		glitch_target();
	}
	return 0;
}
```

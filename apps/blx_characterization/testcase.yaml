## apps/blx_characterization/testcase.yaml
```yaml
common:
  platform_allow:
    - glitchtag
  tags:
    - glitchtag
tests:
  apps.blx_characterization.build:
    build_only: true
```

## apps/bx_characterization/testcase.yaml
```yaml
common:
  platform_allow:
    - glitchtag
  tags:
    - glitchtag
tests:
  apps.bx_characterization.build:
    build_only: true
```

## apps/conditional_characterization/testcase.yaml
```yaml
common:
  platform_allow:
    - glitchtag
  tags:
    - glitchtag
tests:
  apps.conditional_characterization.build:
    build_only: true
```

## apps/countermeasure_delays/testcase.yaml
```yaml
common:
  platform_allow:
    - glitchtag
  tags:
    - glitchtag
tests:
  apps.countermeasure_delays.build:
    build_only: true
```

## apps/countermeasure_double_read/testcase.yaml
```yaml
common:
  platform_allow:
    - glitchtag
  tags:
    - glitchtag
tests:
  apps.countermeasure_double_read.build:
    build_only: true
```

## apps/countermeasure_secbool/testcase.yaml
```yaml
common:
  platform_allow:
    - glitchtag
  tags:
    - glitchtag
tests:
  apps.countermeasure_secbool.build:
    build_only: true
```

## apps/firmware_print_glitch/testcase.yaml
```yaml
common:
  platform_allow:
    - glitchtag
  tags:
    - glitchtag
tests:
  apps.firmware_print_glitch.build:
    build_only: true
```

## apps/int_characterization_basic/testcase.yaml
```yaml
common:
  platform_allow:
    - glitchtag
  tags:
    - glitchtag
tests:
  apps.int_characterization_basic.build:
    build_only: true
```

## apps/ldm_characterization/testcase.yaml
```yaml
common:
  platform_allow:
    - glitchtag
  tags:
    - glitchtag
tests:
  apps.ldm_characterization.build:
    build_only: true
```

## apps/mov_characterization_all_registers/testcase.yaml
```yaml
common:
  platform_allow:
    - glitchtag
  tags:
    - glitchtag
tests:
  apps.mov_characterization_all_registers.build:
    build_only: true
```

## apps/mov_characterization_basic/testcase.yaml
```yaml
common:
  platform_allow:
    - glitchtag
  tags:
    - glitchtag
tests:
  apps.mov_characterization_basic.build:
    build_only: true
```

## apps/password_glitch/testcase.yaml
```yaml
common:
  platform_allow:
    - glitchtag
  tags:
    - glitchtag
tests:
  apps.password_glitch.build:
    build_only: true
```

## apps/simple_glitch/testcase.yaml
```yaml
common:
  platform_allow:
    - glitchtag
  tags:
    - glitchtag
tests:
  apps.simple_glitch.build:
    build_only: true
```

## boards/arm/hextree_glitchtag/Kconfig.defconfig
```kconfig
# Copyright (c) 2024 Nordic Semiconductor ASA
# SPDX-License-Identifier: Apache-2.0

if BOARD_HEXTREE_GLITCHTAG

config BOARD
	default "hextree_glitchtag"

config BT_CTLR
   default BT


endif
```

## boards/arm/hextree_glitchtag/hextree_glitchtag_defconfig
```kconfig
# Copyright (c) 2024 Nordic Semiconductor ASA
# SPDX-License-Identifier: Apache-2.0

CONFIG_SOC_SERIES_NRF52X=y
CONFIG_SOC_NRF52832_QFAA=y
CONFIG_BOARD_HEXTREE_GLITCHTAG=y

# Enable MPU
CONFIG_ARM_MPU=y

# Enable hardware stack protection
CONFIG_HW_STACK_PROTECTION=y
CONFIG_CLOCK_CONTROL_NRF_K32SRC_RC=y


# enable uart driver
CONFIG_SERIAL=y

# enable console
CONFIG_CONSOLE=n
CONFIG_UART_CONSOLE=n
```

## boards/hextree/glitchtag/Kconfig.defconfig
```kconfig
# Copyright (c) 2024 Nordic Semiconductor ASA
# SPDX-License-Identifier: Apache-2.0

if BOARD_GLITCHTAG

config BOARD
	default "glitchtag"

endif
```

## boards/hextree/glitchtag/board.yml
```yaml
board:
  name: glitchtag
  full_name: Hextree GlitchTag
  vendor: hextree
  socs:
  - name: nrf52832
```

## boards/hextree/hextree_glitchtag/Kconfig.defconfig
```kconfig
# Copyright (c) 2024 Nordic Semiconductor ASA
# SPDX-License-Identifier: Apache-2.0

if BOARD_HEXTREE_GLITCHTAG

config BOARD
	default "hextree_glitchtag"

endif
```

## boards/hextree/hextree_glitchtag/hextree_glitchtag_defconfig
```kconfig
# Copyright (c) 2024 Nordic Semiconductor ASA
# SPDX-License-Identifier: Apache-2.0

# Enable MPU
CONFIG_ARM_MPU=y

# Enable hardware stack protection
CONFIG_HW_STACK_PROTECTION=y
CONFIG_CLOCK_CONTROL_NRF_K32SRC_RC=y

# enable uart driver
CONFIG_SERIAL=y

# enable console
CONFIG_CONSOLE=n
CONFIG_UART_CONSOLE=n
```

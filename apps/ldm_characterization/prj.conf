## CMakeLists.txt
```
# SPDX-License-Identifier: Apache-2.0

cmake_minimum_required(VERSION 3.20.0)

find_package(Zephyr REQUIRED)
project(app)
target_sources(app PRIVATE src/ldm_characterization.c)
```

## prj.conf
```kconfig
CONFIG_SERIAL=y
CONFIG_UART_INTERRUPT_DRIVEN=y
CONFIG_GPIO=y
CONFIG_KERNEL_BIN_NAME="ldm_characterization"
```

## src/ldm_characterization.c
```c
#include "uart.h"
#include "gpio.h"

#pragma GCC push_options
#pragma GCC optimize("O0")

uint32_t load_data = 0x12345678;

__ramfunc void glitch_target() {
	//  Indicate reset to our glitcher
	print_uart("RST");

	uint32_t register_output[14] = {0};

	// Generate a short trigger signal on IO 2
	gpio_pin_set_dt(&trigger, 1);
	k_msleep(1);
	gpio_pin_set_dt(&trigger, 0);

	// 1 setup instruction + 20 NOPs
	__asm(
		"ldr r0, =load_data;"
		"NOP; NOP; NOP; NOP; NOP; NOP; NOP; NOP; NOP; NOP;"
		"NOP; NOP; NOP; NOP; NOP; NOP; NOP; NOP; NOP; NOP;"
		"ldm r0, {r1};"
		"NOP; NOP; NOP; NOP; NOP; NOP; NOP; NOP; NOP; NOP;"
		"NOP; NOP; NOP; NOP; NOP; NOP; NOP; NOP; NOP; NOP;"
		"stm %[register_output], {r0-r12, lr};"
		: 
		: [register_output]"r"(register_output)
		: "r0", "r1", "memory");
	
	print_uart("OKAY");

	// Send all 14 registers to the host
	write_uart((char *)register_output, sizeof(register_output));

	while(1) {}
}

#pragma GCC pop_options

int main(void)
{
	if(setup_gpio()) {
		return 0;
	}

	if(setup_uart()) {
		return 0;
	}

	while(1) {
		glitch_target();
	}
	return 0;
}
```
